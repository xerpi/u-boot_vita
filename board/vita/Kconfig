## board/vita/Kconfig
```kconfig
if TARGET_VITA

config SYS_SOC
	default "vita"

config SYS_BOARD
	default "vita"

config SYS_CONFIG_NAME
	default "vita"

endif
```

## configs/vita_defconfig
```kconfig
CONFIG_ARM=y
CONFIG_POSITION_INDEPENDENT=y
CONFIG_SYS_ARM_CACHE_CP15=y
# CONFIG_SYS_ARM_MMU is not set
CONFIG_TARGET_VITA=y
CONFIG_TEXT_BASE=0x40300000
CONFIG_SYS_LOAD_ADDR=0x40300000
CONFIG_DEBUG_LL=y
CONFIG_DEBUG_LL_UART_VITA=y
CONFIG_DEBUG_UART_PHYS=0xE2030000
CONFIG_SYS_BOOTM_LEN=0x4000000
CONFIG_BOARD_EARLY_INIT_F=y
CONFIG_CMD_LZMADEC=y
CONFIG_CMD_UNLZ4=y
CONFIG_CMD_UNZIP=y
CONFIG_CMD_DM=y
CONFIG_OF_CONTROL=y
CONFIG_OF_OMIT_DTB=y
# CONFIG_OF_TAG_MIGRATE is not set
CONFIG_CPU=y
CONFIG_FIRMWARE=y
CONFIG_SPI=y
CONFIG_PANIC_HANG=y
```
